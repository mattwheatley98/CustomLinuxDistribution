## rpi-build/conf/bblayers.conf
```bitbake
# POKY_BBLAYERS_CONF_VERSION is increased each time build/conf/bblayers.conf
# changes incompatibly
POKY_BBLAYERS_CONF_VERSION = "2"

BBPATH = "${TOPDIR}"
BBFILES ?= ""

BBLAYERS ?= " \
  /home/matt/Projects/projectyocto/poky/meta \
  /home/matt/Projects/projectyocto/poky/meta-poky \
  /home/matt/Projects/projectyocto/poky/meta-yocto-bsp \
  /home/matt/Projects/projectyocto/meta-raspberrypi \
  /home/matt/Projects/projectyocto/meta-custom \
  "
```
